## kernel/oipc_saz1051.its
```
/*
 * SAZ1051 (Hi3516CV610) FIT 镜像描述 —— 交付给 U-Boot 的内核必须是 FIT。
 *
 * 为什么不能用 legacy uImage:
 *   本机 U-Boot 2022.07 未编译 CONFIG_SYS_BOOT_LEGACY / ATAGS 支持, `bootm` 一个旧式
 *   uImage 会报 "FDT and ATAGS support not compiled in" 并直接 reset。
 *   实测踩过。故内核 + DTB 必须打成 FIT(.itb), 由 FAT 的 fdt 子镜像携带 DTB。
 *
 * 用法(在 stage 目录, 与 hi3516cv610-demb.dtb / zImage 同目录):
 *   mkimage -f oipc_saz1051.its uImage.itb
 *
 * 地址与板子上 U-Boot 的默认 loadaddr 约定一致:
 *   linux_kernel @ 0x40018000 (load=entry=0x40018000)
 *   fdt-1        @ 0x40000000
 * 内核 cmdline 由 U-Boot 的 bootargs 提供(CONFIG_CMDLINE_EXTEND 会把它拼在内置 cmdline 之后)。
 */
/dts-v1/;

/ {
    description = "OpenIPC SAZ1051 Hi3516CV610";
    #address-cells = <1>;

    images {
        fdt-1 {
            description = "dtb";
            data = /incbin/("hi3516cv610-demb.dtb");
            type = "flat_dt";
            arch = "arm";
            compression = "none";
            load = <0x40000000>;
        };
        linux_kernel {
            description = "Linux";
            data = /incbin/("zImage");
            type = "kernel";
            arch = "arm";
            os = "linux";
            compression = "none";
            load = <0x40018000>;
            entry = <0x40018000>;
        };
    };

    configurations {
        default = "config-1";
        config-1 {
            description = "OpenIPC";
            kernel = "linux_kernel";
            fdt = "fdt-1";
            loadables = "linux_kernel", "fdt-1";
        };
    };
};
```
